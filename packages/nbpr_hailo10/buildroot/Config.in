## packages/nbpr_hailo10/buildroot/Config.in
```kconfig
source "$BR2_EXTERNAL_NBPR_HAILO10_PATH/package/spdlog_hailort/Config.in"
source "$BR2_EXTERNAL_NBPR_HAILO10_PATH/package/hailort/Config.in"
source "$BR2_EXTERNAL_NBPR_HAILO10_PATH/package/hailort-firmware/Config.in"
source "$BR2_EXTERNAL_NBPR_HAILO10_PATH/package/hailort-drivers/Config.in"
```

## packages/nbpr_hailo10/buildroot/package/hailort-firmware/Config.in
```kconfig
config BR2_PACKAGE_HAILORT_FIRMWARE
	bool "hailort-firmware"
	help
	  Hailo-10H firmware bundle (u-boot, SCU, fitImage, signed DTBs).
	  Version-matched to HailoRT v5.

	  https://github.com/hailo-ai/hailort-drivers/blob/master/download_firmware_hailo10h.sh
```

## packages/nbpr_hailo8/buildroot/Config.in
```kconfig
source "$BR2_EXTERNAL_NBPR_HAILO8_PATH/package/spdlog_hailort/Config.in"
source "$BR2_EXTERNAL_NBPR_HAILO8_PATH/package/hailort/Config.in"
source "$BR2_EXTERNAL_NBPR_HAILO8_PATH/package/hailort-firmware/Config.in"
source "$BR2_EXTERNAL_NBPR_HAILO8_PATH/package/hailort-drivers/Config.in"
```

## packages/nbpr_hailo8/buildroot/package/hailort-drivers/Config.in
```kconfig
config BR2_PACKAGE_HAILORT_DRIVERS
	bool "hailort-drivers"
	depends on BR2_LINUX_KERNEL
	depends on BR2_PACKAGE_HAILORT
	select BR2_PACKAGE_HAILORT_FIRMWARE
	help
	  HailoRT PCIe driver (hailo_pci) for Hailo-8/8L accelerators.
	  Built as an out-of-tree kernel module against the active system's
	  kernel.

	  https://github.com/hailo-ai/hailort-drivers

comment "hailort-drivers needs a Linux kernel to be built"
	depends on !BR2_LINUX_KERNEL
```

## packages/nbpr_hailo8/buildroot/package/hailort-firmware/Config.in
```kconfig
config BR2_PACKAGE_HAILORT_FIRMWARE
	bool "hailort-firmware"
	help
	  Hailo-8 device firmware blob, loaded onto the accelerator by the
	  PCIe driver at probe time. Version-matched to HailoRT.

	  https://github.com/hailo-ai/hailort-drivers/blob/hailo8/download_firmware.sh
```

## packages/nbpr_librespot/priv/buildroot/package/librespot/Config.in
```kconfig
config BR2_PACKAGE_LIBRESPOT
	bool "librespot"
	depends on BR2_PACKAGE_HOST_RUSTC_TARGET_ARCH_SUPPORTS
	depends on BR2_TOOLCHAIN_HAS_THREADS
	depends on !BR2_STATIC_LIBS
	select BR2_PACKAGE_HOST_RUSTC
	select BR2_PACKAGE_ALSA_LIB
	select BR2_PACKAGE_ALSA_LIB_PCM
	help
	  An open source client library for Spotify. It offers a device
	  that any Spotify application can cast to, over the Spotify
	  Connect protocol.

	  A Spotify Premium account is required. The project says of
	  itself that using it to connect to Spotify's API is probably
	  forbidden by them.

	  https://github.com/librespot-org/librespot

comment "librespot needs a toolchain w/ threads, dynamic library"
	depends on BR2_PACKAGE_HOST_RUSTC_TARGET_ARCH_SUPPORTS
	depends on !BR2_TOOLCHAIN_HAS_THREADS || BR2_STATIC_LIBS
```
